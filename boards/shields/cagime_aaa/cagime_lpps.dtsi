#define LPPS_BUS spi0
#define LPPS_DEFAULT cagime_lpps_default
#define LPPS_SLEEP cagime_lpps_sleep
#define LPPS_ADC cagime_lpps_adc
#define LPPS_AXES cagime_lpps_axes
#define LPPS_NODE lpps-axes
#include "cagime_lpps_slot.dtsi"
