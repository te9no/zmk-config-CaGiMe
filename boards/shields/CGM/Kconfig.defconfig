## boards/shields/CGM/Kconfig.defconfig
```kconfig
if SHIELD_CGM_LEFT || SHIELD_CGM_RIGHT

config ZMK_ZEROSHIFT
    default y if !ZMK_SETTINGS_RESET_ON_START

config ZMK_ZEROSHIFT_SLOT_COUNT
    default 2

config ZMK_ZEROSHIFT_SETTINGS_SUBTREE
    default "cagime"

config ZMK_ZEROSHIFT_SETTINGS_KEY
    default "modules-v1"

config ZMK_SPLIT
    default y

config ZMK_KEYBOARD_NAME
    default "CaGiMe"

if SHIELD_CGM_LEFT

config ZMK_SPLIT_ROLE_CENTRAL
    default y

config ZMK_SPLIT_BLE_CENTRAL_PERIPHERALS
    default 1

endif
endif

if SHIELD_CGM_RIGHT || SHIELD_CGM_LEFT

config ADC_ADS1220
    default y

config INPUT_ANALOG_AXIS_HIRES_SETTINGS
    default n

config INPUT_ANALOG_AXIS_HIRES_THREAD_STACK_SIZE
    default 2048

config INPUT_ANALOG_AXIS_HIRES_THREAD_PRIORITY
    default 9

config PM_DEVICE
    default y

endif
```

## boards/shields/CGM/Kconfig.shield
```kconfig
config SHIELD_CGM_LEFT
    def_bool $(shields_list_contains,CGM_left)

config SHIELD_CGM_RIGHT
    def_bool $(shields_list_contains,CGM_right)
```

## boards/shields/cagime_aaa/Kconfig.shield
```kconfig
config SHIELD_CAGIME_AAA_LEFT
    def_bool $(shields_list_contains,cagime_aaa_left)

config SHIELD_CAGIME_AAA_RIGHT
    def_bool $(shields_list_contains,cagime_aaa_right)
```

## dts/bindings/cagime,zeroshift-socket.yaml
```yaml
# SPDX-License-Identifier: MIT
description: CaGiMe interchangeable module socket and its stable keymap positions
compatible: "cagime,zeroshift-socket"
include: base.yaml
properties:
  matrix-row:
    type: int
    required: true
  matrix-column:
    type: int
    required: true
  sensor-index:
    type: int
    required: true
  trackball:
    type: phandle
  encoder:
    type: phandle
  push-key:
    type: phandle
  touchpad:
    type: phandle
  optical-dial:
    type: phandle
  lpps-adc:
    type: phandle
  lpps-axes:
    type: phandle
  counts-per-revolution:
    type: int
    description: Optical dial X counts per full turn
  has-stick:
    type: boolean
```

## dts/bindings/input/cagime,analog-stick.yaml
```yaml
# SPDX-License-Identifier: MIT

description: CaGiMe lower FPC analog stick
compatible: "cagime,analog-stick"
include: base.yaml

properties:
  io-channels:
    type: phandle-array
    required: true
    description: ADC channels, in X then Y order and ascending channel number
  center-mv:
    type: int
    required: true
  deadzone-mv:
    type: int
    required: true
  mv-per-step:
    type: int
    required: true
  sample-period-ms:
    type: int
    required: true
```
